## Windows/qemu-tricore/Kconfig
```kconfig
# Kconfig file for package qemu-tricore
menuconfig PKG_USING_QEMU_TRICORE
    bool "qemu-tricore emulator"
    default n

if PKG_USING_QEMU_TRICORE

    config PKG_QEMU_TRICORE_PATH
        string
        default "sdk/Windows/qemu-tricore"

    choice
        prompt "Version"
        help
            Select the package version

        config PKG_USING_QEMU_TRICORE_V100
            bool "v1.0.0"

    endchoice

    config PKG_QEMU_TRICORE_VER
       string
       default "v1.0.0" if PKG_USING_QEMU_TRICORE_V100

endif
```

## Windows/tricore-gcc/Kconfig
```kconfig
# Kconfig file for package tricore-gcc
menuconfig PKG_USING_TRICORE_GCC
    bool "tricore-gcc toolchain"
    default n

if PKG_USING_TRICORE_GCC

    config PKG_TRICORE_GCC_PATH
        string
        default "sdk/Windows/tricore-gcc"

    choice
        prompt "Version"
        help
            Select the package version

        config PKG_USING_TRICORE_GCC_V1341
            bool "v13.4.1"

    endchoice

    config PKG_TRICORE_GCC_VER
       string
       default "v13.4.1" if PKG_USING_TRICORE_GCC_V1341

endif
```
