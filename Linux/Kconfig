## Linux/Kconfig
```kconfig
source "$PKGS_DIR/sdk/$HOSTOS/arm-none-eabi-gcc/Kconfig"
source "$PKGS_DIR/sdk/$HOSTOS/aarch64-none-elf-gcc/Kconfig"
```

## Linux/arm-none-eabi-gcc/Kconfig
```kconfig
# Kconfig file for package arm-none-eabi-gcc
menuconfig PKG_USING_ARM_NONE_EABI_GCC
    bool "arm-none-eabi-gcc toolchain"
    default n

if PKG_USING_ARM_NONE_EABI_GCC

    config PKG_ARM_NONE_EABI_GCC_PATH
        string
        default "sdk/Linux/arm-none-eabi-gcc"

    choice
        prompt "Version"
        help
            Select the package version

        config PKG_USING_ARM_NONE_EABI_GCC_V1021
            bool "v10.2.1"
    endchoice

    config PKG_ARM_NONE_EABI_GCC_VER
       string
       default "v10.2.1"   if PKG_USING_ARM_NONE_EABI_GCC_V1021

endif
```
